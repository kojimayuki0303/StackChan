## firmware/sdkconfig.defaults.usb-speaker
```kconfig
# USB playback only. The speaker codec remains at its native 24 kHz rate.
CONFIG_STACKCHAN_USB_SPEAKER=y
CONFIG_UAC_TUSB_PRODUCT="PonChan USB Speaker"
CONFIG_UAC_TUSB_MANUFACTURER="PonChan"
CONFIG_UAC_TUSB_SERIAL_NUM="PonChan-Speaker-01"
CONFIG_UAC_SPEAKER_CHANNEL_NUM=2
CONFIG_UAC_MIC_CHANNEL_NUM=0
CONFIG_UAC_SAMPLE_RATE=24000
CONFIG_UAC_BIT_RESOLUTION_16=y
CONFIG_UAC_SUPPORT_MACOS=y
CONFIG_UAC_SPK_INTERVAL_MS=20
CONFIG_ESP_CONSOLE_SECONDARY_NONE=y
# CONFIG_ESP_CONSOLE_SECONDARY_USB_SERIAL_JTAG is not set
# CONFIG_USJ_ENABLE_USB_SERIAL_JTAG is not set
CONFIG_WAKE_WORD_DISABLED=y
# CONFIG_USE_ESP_WAKE_WORD is not set
# CONFIG_USE_AFE_WAKE_WORD is not set
```
